## boards/imx93/frdm-imx93/linux-uimage.its
```
/dts-v1/;

/ {
    description = "Linux FIT image for FRDM IMX93";
    #address-cells = <1>;

    images {
        kernel {
            description = "Linux kernel";
            data = /incbin/("Image");
            type = "kernel";
            arch = "arm64";
            os = "linux";
            compression = "none";
            /* 1. Use a little offstet (e.g., 8MB) after DRAM start address */
            load = <0x80800000>;
            entry = <0x80800000>;
        };
        fdt {
            description = "Device tree";
            data = /incbin/("imx93-11x11-evk.dtb");
            type = "flat_dt";
            arch = "arm64";
            compression = "none";
            /* 2. Place device tree after kernel (64MB spacing) */
            load = <0x84800000>;
        };
        initrd {
            description = "Ramdisk";
            data = /incbin/("rootfs.cpio");
            type = "ramdisk";
            arch = "arm64";
            os = "linux";
            compression = "none";
            /* 3. Place initramdisk last (1MB spacing) */
            load = <0x84900000>;
        };
    };

    configurations {
        default = "normal-boot";

        normal-boot {
            description = "Normal boot config";
            kernel = "kernel";
            fdt = "fdt";
            ramdisk = "initrd";
        };
    };
};
```
